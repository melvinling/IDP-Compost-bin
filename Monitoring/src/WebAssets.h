// Generated by tools/bundle_web.py; edit web/ sources, then regenerate.
#pragma once
#include <Arduino.h>

const char WEB_INDEX[] PROGMEM = R"COMPOST_ASSET(<!doctype html>
<html lang="en">
<head>
<meta charset="utf-8"><meta name="viewport" content="width=device-width,initial-scale=1">
<meta name="theme-color" content="#eef3eb"><title>Compost · Monitor & control</title>
<link rel="stylesheet" href="/style.css"><script src="/app.js" defer></script>
</head>
<body><main>
<header><div><p class="eyebrow">ONE BIN · LOCAL ESP32</p><h1>Compost monitor</h1><p>Read the bin. Stay in control.</p></div><span id="connection" class="connection" role="status">Connecting…</span></header>
<section class="control" aria-labelledby="control-title">
<div class="control-heading"><div><h2 id="control-title">Control station</h2><p id="modeStatus">Waiting for device status</p></div><button id="stopAll" class="danger" data-command="stop_all">Stop All</button></div>
<p class="small">Software stop latches relay commands OFF. No actuator feedback is installed.</p>
<div class="mode-row"><span>Operating mode</span><button id="manualMode" data-command="mode_manual">Manual</button><button id="autoMode" data-command="mode_auto">Automatic</button><span id="latchStatus" class="tag">Waiting</span><button id="resetStop" data-command="reset_stop">Reset stop latch</button></div>
<div class="mode-row"><span>Process stage</span><button id="fermentationStage" data-command="stage_fermentation">Sealed fermentation</button><button id="finishingStage" data-command="stage_finishing">Finishing</button><span id="stageStatus" class="small">Waiting</span></div>
<div class="actuators">
<article><h3>Motor</h3><p id="motorState">Requested — · Commanded relay —</p><button id="motorStart" data-command="motor_start">Start · 5 seconds</button><button id="motorStop" data-command="motor_stop">Stop motor</button></article>
<article><h3>Water pump</h3><p id="pumpState">Requested — · Commanded relay —</p><button id="pumpStart" data-command="pump_start">Start · 5 seconds</button><button id="pumpStop" data-command="pump_stop">Stop pump</button></article>
<article><h3>Drying fan</h3><p id="fanState">Requested — · Commanded relay —</p><button id="fanStart" data-command="fan_start">Start · 5 seconds</button><button id="fanStop" data-command="fan_stop">Stop fan</button></article>
</div>
<p id="inhibition" class="notice">Waiting for configuration</p><p id="model" class="small">ML: waiting</p>
<p id="commandMessage" role="status" aria-live="polite" class="command-message"></p>
</section>
<section aria-label="Measurements">
<div class="toolbar"><label for="window">Show last</label><select id="window"><option value="60">1 minute</option><option value="300" selected>5 minutes</option><option value="900">15 minutes</option><option value="1800">30 minutes</option></select><button id="pause">Pause display</button><button id="export" disabled>Download CSV</button><span id="freshness" class="small">Waiting for first sample</span></div>
<div id="sensorNotice" class="notice" role="status">Waiting for sensor readings</div><div id="cards" class="grid"></div>
</section>
<details><summary>About this system</summary><p>Six measurements: distance, EC, pH, CO₂, moisture and temperature. The configurable four-parameter soil profile uses registers 2, 3, 0 and 1 at ID 1 / 4800 baud. CO₂ uses ID 1 / 9600 baud. Actual sensor replies and bus compatibility need hardware verification.</p><p>Samples start every four seconds. Up to 900 samples stay in RAM. All six inputs must be valid and younger than 12 seconds for automatic operation. Display pause does not stop acquisition or control. Manual requests last five seconds; automatic pulses: water 2 seconds, dry 8 seconds, mix 5 seconds. Cooldowns: pump and motor 60 seconds, fan 30 seconds. Fan and pump are mutually exclusive.</p><p>Boot defaults to manual / sealed fermentation, with actuators OFF. Select finishing explicitly to operate them. Stop All latches outputs OFF until reset. Individual stops block that automatic channel until the mode is reselected. Continuous operation is limited to ten seconds.</p><p>The Random Forest was trained on 1,200 artificial examples. Its confidence describes the synthetic model, and its thresholds are demonstration settings. Physical outputs remain disabled until pins, polarity and hardware behavior are verified.</p></details>
<footer><span>Offline by design · no router or cloud</span><span id="historyMeta">60-minute RAM history</span></footer>
</main></body></html>
)COMPOST_ASSET";

const char WEB_STYLE[] PROGMEM = R"COMPOST_ASSET(:root{--paper:#eef3eb;--ink:#213b2c;--muted:#65786b;--line:#d8e2d5;--green:#33764e;--red:#ae3b35}
*{box-sizing:border-box}body{margin:0;background:var(--paper);color:var(--ink);font:15px/1.5 system-ui,-apple-system,Segoe UI,sans-serif}main{max-width:1160px;margin:auto;padding:32px 24px 40px}header{display:flex;justify-content:space-between;align-items:center;gap:16px;margin-bottom:24px}h1{font-size:clamp(30px,5vw,46px);letter-spacing:-.045em;line-height:1.15;margin:5px 0 9px}h2{font-size:20px;margin:0}h3{font-size:15px;margin:0 0 6px}p{margin:0;color:var(--muted)}.eyebrow{color:var(--green);font-size:11px;font-weight:750;letter-spacing:.13em}.connection{border:1px solid var(--line);padding:9px 14px;background:white;border-radius:24px;font-size:13px;white-space:nowrap}.connection.online{color:var(--green)}.connection.offline{color:var(--red)}
button,select{font:inherit;font-size:13px;padding:9px 13px;border:1px solid var(--line);border-radius:8px;background:white;color:var(--ink);cursor:pointer}button:hover{border-color:var(--green)}button:focus-visible,select:focus-visible{outline:3px solid #8fba94;outline-offset:2px}button:disabled{opacity:.48;cursor:default}button[aria-pressed=true]{color:white;background:var(--green);border-color:var(--green)}button.danger{background:var(--red);color:white;border-color:var(--red);font-size:17px;font-weight:700;min-width:140px;min-height:48px}
.control{padding:23px;background:#fff;border:1px solid var(--line);border-radius:15px;margin-bottom:26px}.control-heading{display:flex;align-items:center;justify-content:space-between;gap:16px;margin-bottom:8px}.small{font-size:12px}.mode-row{display:flex;align-items:center;flex-wrap:wrap;gap:8px;margin:18px 0}.mode-row>span:first-child{font-size:13px;margin-right:4px}.tag{font-size:12px;padding:4px 9px;background:var(--paper);border-radius:5px}.actuators{display:grid;grid-template-columns:repeat(3,minmax(0,1fr));gap:14px}.actuators article{background:#f7f9f5;border:1px solid var(--line);border-radius:10px;padding:16px}.actuators p{font-size:12px;margin-bottom:12px}.notice{border:1px solid #e6d7ad;background:#fbf5e5;color:#776027;padding:12px 14px;border-radius:8px;font-size:13px;margin:16px 0 9px}.notice[hidden]{display:none}.command-message{font-size:13px;margin-top:9px;min-height:20px}.command-message.error{color:var(--red)}
.toolbar{display:flex;align-items:center;flex-wrap:wrap;gap:9px;margin-bottom:18px}.toolbar label{font-size:13px}.toolbar .small{margin-left:auto}.grid{display:grid;grid-template-columns:repeat(2,minmax(0,1fr));gap:18px}.card{background:white;border:1px solid var(--line);border-radius:14px;padding:20px;min-width:0}.card h2{font-size:14px;font-weight:600;color:var(--muted)}.reading{display:flex;align-items:baseline;gap:9px;margin-top:9px}.value{font-size:37px;font-weight:650;letter-spacing:-.04em;font-variant-numeric:tabular-nums}.unit{font-size:13px;color:var(--muted)}.sensor-status{font-size:12px;min-height:36px;color:var(--muted)}.plot{height:185px;margin-top:8px}.plot canvas{display:block;width:100%;height:100%}.range{font-size:11px;min-height:17px;color:var(--muted)}details{margin-top:24px;border:1px solid var(--line);border-radius:10px;padding:14px 17px;font-size:13px}summary{font-weight:600;cursor:pointer}details p{margin-top:10px}footer{display:flex;justify-content:space-between;flex-wrap:wrap;gap:10px;font-size:12px;color:var(--muted);margin-top:22px}
@media(max-width:650px){main{padding:22px 14px}header{align-items:flex-start;flex-direction:column}.control{padding:17px}.grid,.actuators{grid-template-columns:1fr}.card{padding:17px}.toolbar .small{width:100%;margin-left:0}.control-heading{align-items:flex-start}.control-heading h2{font-size:18px}button.danger{min-width:105px}.plot{height:175px}}
)COMPOST_ASSET";

const char WEB_APP[] PROGMEM = R"COMPOST_ASSET('use strict';
const definitions = [
 {name:'Distance to surface',unit:'cm',decimals:1,color:'#397d54'},
 {name:'Electrical conductivity',unit:'µS/cm',decimals:0,color:'#b5843d'},
 {name:'Soil pH',unit:'pH',decimals:1,color:'#6489ae'},
 {name:'Carbon dioxide',unit:'ppm',decimals:0,color:'#9576a6'},
 {name:'Moisture',unit:'%',decimals:1,color:'#378994'},
 {name:'Temperature',unit:'°C',decimals:1,color:'#bc6c45'}
];
const $ = id => document.getElementById(id);
const state = {boot:'',after:0,samples:[],meta:null,anchor:0,online:false,paused:false,pending:0,lastResponse:0};
definitions.forEach((d,i)=>{
 const card=document.createElement('article');card.className='card';
 card.innerHTML=`<h2>${d.name}</h2><div class="reading"><span class="value" id="value${i}">—</span><span class="unit">${d.unit}</span></div><p class="sensor-status" id="status${i}">Waiting</p><div class="plot"><canvas id="plot${i}" role="img" aria-label="${d.name} trend"></canvas></div><div class="range" id="range${i}"></div>`;
 $('cards').appendChild(card);
});
function format(v,i){return Number.isFinite(v)?v.toFixed(definitions[i].decimals):'—';}
function clock(t){return new Date(state.anchor+t).toLocaleTimeString([], {hour:'2-digit',minute:'2-digit',second:'2-digit'});}
function drawChart(i){
 const c=$('plot'+i),ctx=c.getContext('2d'),w=c.clientWidth,h=c.clientHeight,ratio=devicePixelRatio||1;
 c.width=Math.round(w*ratio);c.height=Math.round(h*ratio);ctx.setTransform(ratio,0,0,ratio,0,0);ctx.clearRect(0,0,w,h);
 if(w<100)return;
 const end=state.samples.length?state.samples.at(-1)[1]:0,start=Math.max(0,end-Number($('window').value)*1000);
 const rows=state.samples.filter(s=>s[1]>=start),values=rows.map(s=>s[i+2]).filter(Number.isFinite);
 const max=i===2?14:i===4?100:values.length?Math.max(1,...values)*1.12:1;
 const min=i===5&&values.length?Math.min(0,...values)*1.12:0;
 const left=48,top=12,pw=w-60,ph=h-42,x=t=>left+(t-start)/Math.max(1000,end-start)*pw,y=v=>top+ph-(v-min)/(max-min)*ph;
 ctx.font='10px system-ui';ctx.lineWidth=1;
 for(let k=0;k<4;k++){const v=min+(max-min)*k/3,py=y(v);ctx.strokeStyle='#e6ede1';ctx.beginPath();ctx.moveTo(left,py);ctx.lineTo(w-12,py);ctx.stroke();ctx.fillStyle='#748477';ctx.textAlign='right';ctx.fillText(v.toFixed(v<10?1:0),left-7,py+3);}
 ctx.textAlign='left';ctx.fillText(state.samples.length?clock(start):'Time',left,h-7);ctx.textAlign='right';if(state.samples.length)ctx.fillText(clock(end),w-12,h-7);
 if(!values.length){ctx.textAlign='center';ctx.fillText('Waiting for valid readings',left+pw/2,top+ph/2);}
 ctx.strokeStyle=definitions[i].color;ctx.lineWidth=2;ctx.lineJoin='round';ctx.beginPath();
 let previous=null;
 for(const row of rows){const value=row[i+2];if(!Number.isFinite(value)){previous=null;continue;}if(previous===null||row[1]-previous>(state.meta?.sampleMs||4000)*1.75)ctx.moveTo(x(row[1]),y(value));else ctx.lineTo(x(row[1]),y(value));previous=row[1];}
 ctx.stroke();
 const last=rows.at(-1);if(last&&Number.isFinite(last[i+2])){ctx.fillStyle=definitions[i].color;ctx.beginPath();ctx.arc(x(last[1]),y(last[i+2]),3,0,Math.PI*2);ctx.fill();}
 $('range'+i).textContent=values.length?`Min ${format(Math.min(...values),i)} · Max ${format(Math.max(...values),i)} ${definitions[i].unit} · ${values.length} readings`:'Missing readings appear as gaps.';
}
function renderControls(s){
 const on=v=>v?'ON':'OFF';
 $('modeStatus').textContent=`Mode: ${s.mode} · ${state.meta?.simulation?'Virtual relay outputs':`Physical relay configuration ${s.relayConfigured?'enabled':'disabled / unconfigured'}`}`;
 $('stageStatus').textContent=`${s.stage} · ${(s.stageElapsedMs/60000).toFixed(1)} min · ${s.postWaterMixDue?'Mix after watering due':s.periodicMixDue?'Periodic mix due':'Mix timer running'}`;
 $('fermentationStage').setAttribute('aria-pressed',String(s.stage==='fermentation'));$('finishingStage').setAttribute('aria-pressed',String(s.stage==='finishing'));
 $('manualMode').setAttribute('aria-pressed',String(s.mode==='manual'));$('autoMode').setAttribute('aria-pressed',String(s.mode==='auto'));
 $('latchStatus').textContent=s.stopLatched?'STOP LATCHED':'Stop latch clear';
 for(const name of ['motor','pump','fan'])$(''+name+'State').textContent=`Requested ${on(s.requested[name])} · Commanded relay ${on(s.commanded[name])} · Cooldown ${(s.cooldownMs[name]/1000).toFixed(0)}s`;
 $('inhibition').textContent=s.reason;
 $('model').textContent=`Synthetic Random Forest · ${s.prediction.modelReady?`${s.prediction.action} (${(s.prediction.confidence*100).toFixed(1)}%)`:'inputs unavailable'} · ${s.prediction.reason}`;
 document.querySelectorAll('[data-command]').forEach(b=>{
  const command=b.dataset.command,start=command.endsWith('_start'),stop=command==='stop_all'||command.endsWith('_stop')&&command!=='reset_stop';
  b.disabled=!state.online||(!stop&&state.pending>0)||(start&&(!s.relayConfigured||s.stopLatched||s.mode!=='manual'||s.stage!=='finishing'))||(command==='reset_stop'&&!s.stopLatched);
 });
}
function renderReadings(){
 if(!state.meta)return;
 const elapsed=state.meta.simulation?0:Date.now()-state.lastResponse,latest=state.meta.latest;
 definitions.forEach((d,i)=>{
  const r=latest.readings[i],fresh=state.online&&r.valid&&r.ageMs+elapsed<(state.meta.freshMs||12000);
  $('value'+i).textContent=fresh?format(r.value,i):'—';
  $('status'+i).textContent=!state.online?'Connection lost · history retained':r.valid&&!fresh?'Stale reading':r.status;
  drawChart(i);
 });
 $('freshness').textContent=latest.sequence?`Sample #${latest.sequence} · ${clock(latest.uptime)} · every ${(state.meta.sampleMs||4000)/1000} seconds`:'Waiting for first sample';
 $('export').disabled=!state.samples.length;
 $('historyMeta').textContent=`${state.samples.length} / 900 samples · RAM clears on restart`;
}
function acceptData(data){
 if(state.boot!==data.boot||data.reset){state.samples=[];state.after=0;state.boot=data.boot;state.paused=false;$('pause').textContent='Pause display';}
 state.online=true;state.lastResponse=Date.now();if(!data.simulation||!state.meta||state.meta.boot!==data.boot)state.anchor=Date.now()-data.uptime;
 for(const row of data.samples){if(row[0]>state.after){state.samples.push(row);state.after=row[0];}}
 if(state.samples.length>900)state.samples.splice(0,state.samples.length-900);
 state.meta=data;
 $('connection').className='connection online';$('connection').textContent=state.paused?'Connected · display paused':data.simulation?'Local simulator connected':'Connected to ESP32';
 const stale=!data.latest.sequence||data.latest.readings.some(r=>!r.valid||r.ageMs>=(data.freshMs||12000));
 $('sensorNotice').hidden=!stale;$('sensorNotice').textContent=stale?'One or more sensors are unavailable or stale. See each sensor status.':'';
 renderControls(data.status);if(!state.paused)renderReadings();
 document.dispatchEvent(new Event('monitor-state'));
}
function markOffline(){
 state.online=false;$('connection').className='connection offline';$('connection').textContent='Connection lost';
 $('sensorNotice').hidden=false;$('sensorNotice').textContent=state.meta?.simulation?'Simulator connection lost. Check that its terminal is running; the page will retry.':'Reconnect to CompostControl Wi-Fi. Readings and control status will retry automatically.';
 definitions.forEach((d,i)=>{$('value'+i).textContent='—';$('status'+i).textContent='Connection lost · history retained';});
 document.querySelectorAll('[data-command]').forEach(b=>b.disabled=true);
 document.dispatchEvent(new Event('monitor-state'));
}
async function poll(){
 const controller=new AbortController(),timer=setTimeout(()=>controller.abort(),5000);let more=false;
 try{
  const response=await fetch(`/api/data?after=${state.after}&boot=${encodeURIComponent(state.boot)}`,{cache:'no-store',signal:controller.signal});
  if(!response.ok)throw Error('HTTP '+response.status);
  const data=await response.json();acceptData(data);more=data.more;
 }catch(error){markOffline();}
 finally{clearTimeout(timer);setTimeout(poll,more?20:state.meta?.simulation?250:2000);}
}
async function sendCommand(command){
 if(!state.online||!state.meta)return;
 state.pending++;renderControls(state.meta.status);$('commandMessage').className='command-message';$('commandMessage').textContent='Waiting for device acknowledgement…';
 const controller=new AbortController(),timer=setTimeout(()=>controller.abort(),5000);
 try{
  const response=await fetch('/api/control',{method:'POST',headers:{'Content-Type':'application/x-www-form-urlencoded','X-Control-Token':state.meta.controlToken},body:new URLSearchParams({command}),signal:controller.signal});
  const data=await response.json();
  state.meta.status=data.status;renderControls(data.status);
  $('commandMessage').textContent=data.message;$('commandMessage').className='command-message'+(data.accepted?'':' error');
 }catch(error){$('commandMessage').textContent='No acknowledgement. Command outcome unknown; reconnect to read authoritative device status.';$('commandMessage').className='command-message error';markOffline();}
 finally{clearTimeout(timer);state.pending--;if(state.online)renderControls(state.meta.status);}
}
function csvText(){
 const rows=['time_utc,uptime_seconds,distance_cm,ec_uS_cm,pH,co2_ppm,moisture_pct,temperature_c'];
 for(const s of state.samples)rows.push([new Date(state.anchor+s[1]).toISOString(),(s[1]/1000).toFixed(3),...s.slice(2).map(v=>Number.isFinite(v)?v:'')].join(','));
 return rows.join('\r\n');
}
document.querySelectorAll('[data-command]').forEach(b=>b.addEventListener('click',()=>sendCommand(b.dataset.command)));
$('pause').addEventListener('click',()=>{state.paused=!state.paused;$('pause').textContent=state.paused?'Resume display':'Pause display';if(state.online){$('connection').textContent=state.paused?'Connected · display paused':state.meta.simulation?'Local simulator connected':'Connected to ESP32';if(!state.paused)renderReadings();}});
$('window').addEventListener('change',()=>{if(!state.paused)definitions.forEach((d,i)=>drawChart(i));});
$('export').addEventListener('click',()=>{const url=URL.createObjectURL(new Blob([csvText()],{type:'text/csv;charset=utf-8'}));const link=document.createElement('a');link.href=url;link.download='compost-readings.csv';link.click();setTimeout(()=>URL.revokeObjectURL(url),1000);});
let resizeTimer;addEventListener('resize',()=>{clearTimeout(resizeTimer);resizeTimer=setTimeout(()=>{if(!state.paused)definitions.forEach((d,i)=>drawChart(i));},100);});
setInterval(()=>{if(state.online&&!state.paused)renderReadings();},1000);
definitions.forEach((d,i)=>drawChart(i));poll();
)COMPOST_ASSET";
